## hw/adc/Kconfig
```kconfig
config STM32F2XX_ADC
    bool

config STC8G_ADC
    bool
    select REGISTER

config RK3566_SARADC
    bool
    select REGISTER

config RK3588_SARADC
    bool
```

## hw/arm/rk3566/Kconfig
```kconfig
# Copyright (c) 2026 Process Mission
#
# SPDX-License-Identifier: GPL-2.0-or-later

config RK3566
    bool
    default y
    depends on TCG && AARCH64
    select ARM_GIC
    select CPU_CLUSTER
    select DEVICE_TREE
    select DW8250
    select RK3X_I2C
    select ROCKCHIP_GPIO
    select ROCKCHIP_DWCMSHC
    select ROCKCHIP_SYSCON
    select RK3588_SCMI
    select SDHCI
    select SERIAL_MM
    select PTIMER
    select PL330
    select OR_IRQ
    select DWC3_UDC
    select K230_WDT
    select ROCKCHIP_SPI
    select DW_MMC
    select VIRTIO_MMIO
    select RK3588_RKNPU
    select ROCKCHIP_IOMMU
```

## hw/gpio/Kconfig
```kconfig
config PL061
    bool

config DW_APB_GPIO
    bool

config GPIO_KEY
    bool

config GPIO_MPC8XXX
    bool

config GPIO_PWR
    bool

config SIFIVE_GPIO
    bool


config ROCKCHIP_GPIO
    bool

config STC32G_GPIO
    bool
    select REGISTER

config STC8G_GPIO
    bool
    select REGISTER

config STM32L4X5_GPIO
    bool

config STM32G474_GPIO
    bool
    select REGISTER

config PCA9552
    bool
    depends on I2C

config PCA9554
    bool
    depends on I2C

config PCF8574
    bool
    depends on I2C

config ZAURUS_SCOOP
    bool
```

## hw/mcs251/Kconfig
```kconfig
# SPDX-License-Identifier: GPL-2.0-or-later

config STC32G144K246
    bool
    default y
    depends on MCS251
```

## hw/mcs51/Kconfig
```kconfig
# Copyright (c) 2026 Process Mission
#
# SPDX-License-Identifier: GPL-2.0-or-later

# MCS-51 family SoCs and machines

config STC32G_DSP
    bool
    depends on MCS251
    select REGISTER

config STC32G_TFPU
    bool
    depends on MCS251
    select REGISTER
```

## hw/riscv/Kconfig
```kconfig
config RISCV_IOMMU
    bool

config RISCV_NUMA
    bool

config IBEX
    bool

# RISC-V machines in alphabetical order

config MICROCHIP_PFSOC
    bool
    default y
    depends on RISCV64
    select CADENCE_SDHCI
    select CPU_CLUSTER
    select DEVICE_TREE
    select MCHP_PFSOC_DMC
    select MCHP_PFSOC_IOSCB
    select MCHP_PFSOC_MMUART
    select MCHP_PFSOC_SYSREG
    select RISCV_ACLINT
    select SIFIVE_PDMA
    select SIFIVE_PLIC
    select UNIMP

config MICROBLAZE_V
    bool
    default y
    depends on RISCV32 || RISCV64
    select XILINX
    select XILINX_AXI
    select XILINX_ETHLITE

config OPENTITAN
    bool
    default y
    depends on RISCV32
    select IBEX
    select SIFIVE_PLIC
    select UNIMP

config RISCV_VIRT
    bool
    default y
    depends on RISCV32 || RISCV64
    imply PCI_DEVICES
    imply VIRTIO_VGA
    imply TEST_DEVICES
    imply TPM_TIS_SYSBUS
    select DEVICE_TREE
    select RISCV_NUMA
    select GOLDFISH_RTC
    select PCI
    select PCI_EXPRESS_GENERIC_BRIDGE
    select PFLASH_CFI01
    select SERIAL_MM
    select RISCV_ACLINT
    select RISCV_APLIC
    select RISCV_IOMMU
    select RISCV_IMSIC
    select SIFIVE_PLIC
    select SIFIVE_TEST
    select SMBIOS
    select VIRTIO_MMIO
    select FW_CFG_DMA
    select PLATFORM_BUS
    select ACPI
    select ACPI_PCI

config RISCV_SERVER_PLATFORM_REF
    bool
    default y
    depends on RISCV64
    imply TPM_TIS_SYSBUS
    select RISCV_NUMA
    select GOLDFISH_RTC
    select PCI
    select PCI_EXPRESS_GENERIC_BRIDGE
    select PFLASH_CFI01
    select SERIAL
    select RISCV_ACLINT
    select RISCV_APLIC
    select RISCV_IMSIC
    select RISCV_IOMMU

config SPACEMIT_K3
    bool
    default y
    depends on RISCV64
    select CPU_CLUSTER
    select DEVICE_TREE
    select RISCV_ACLINT
    select RISCV_APLIC
    select RISCV_IMSIC
    select RISCV_IOMMU
    select SERIAL_MM
    select SPACEMIT_K3_CTRL
    select SPACEMIT_K3_SDHCI

config SHAKTI_C
    bool
    default y
    depends on RISCV64
    select RISCV_ACLINT
    select SHAKTI_UART
    select SIFIVE_PLIC
    select UNIMP

config SIFIVE_E
    bool
    default y
    depends on RISCV32 || RISCV64
    select RISCV_ACLINT
    select SIFIVE_GPIO
    select SIFIVE_PLIC
    select SIFIVE_UART
    select SIFIVE_E_PRCI
    select SIFIVE_E_AON
    select UNIMP

config SIFIVE_U
    bool
    default y
    depends on RISCV32 || RISCV64
    select CADENCE
    select CPU_CLUSTER
    select DEVICE_TREE
    select RISCV_ACLINT
    select SIFIVE_GPIO
    select SIFIVE_PDMA
    select SIFIVE_PLIC
    select SIFIVE_SPI
    select SIFIVE_UART
    select SIFIVE_U_OTP
    select SIFIVE_U_PRCI
    select SIFIVE_PWM
    select SSI_M25P80
    select SSI_SD
    select UNIMP

config SPIKE
    bool
    default y
    depends on RISCV32 || RISCV64
    select DEVICE_TREE
    select RISCV_NUMA
    select HTIF
    select RISCV_ACLINT
    select SIFIVE_PLIC

config TENSTORRENT
    bool
    default y
    depends on RISCV64
    select RISCV_ACLINT
    select RISCV_APLIC
    select RISCV_IMSIC
    select SERIAL_MM
    select DEVICE_TREE
    select DESIGNWARE_I2C
    select DS1338
    select TMP105

config XIANGSHAN_KUNMINGHU
    bool
    default y
    depends on RISCV64
    select RISCV_ACLINT
    select RISCV_APLIC
    select RISCV_IMSIC
    select K230_CLINT
    select SERIAL_MM

config MIPS_BOSTON_AIA
    bool
    default y
    depends on RISCV64
    select PCI_EXPRESS
    select PCI_EXPRESS_XILINX
    select RISCV_MIPS_CMGCR
    select RISCV_MIPS_CPC
    select RISCV_MIPS_CPS

config K230
    bool
    default y
    depends on RISCV64
    select RISCV_ACLINT
    select RISCV_APLIC
    select RISCV_IMSIC
    select SERIAL_MM
    select SPLIT_IRQ
    select UNIMP
    select K230_DISPLAY
    select K230_WDT
    select K230_SDHCI
    select K230_GSDMA
    select K230_PDMA
    select K230_UGZIP
    select K230_HI_SYS_CFG
    select K230_HARDLOCK
    select K230_TSENSOR
    select K230_GPIO
    select K230_IOMUX
    select K230_PMU
    select K230_ISP
    select K230_RX_CSI
    select K230_REGS
    select K230_I2S
    select K230_KPU
    select K230_NONAI_2D
    select K230_DEWARP
    select K230_I2C
    select K230_OV5647
    select K230_ADC
    select K230_PWM
    select K230_TIMER
    select K230_SYSCTL
    select K230_RTC
    select K230_SECURITY
    select K230_SPI
    select USB_DWC2
    select USB_RTL8152

config SOPHGO_CV1800B
    bool
    depends on RISCV64
    select RISCV_ACLINT
    select SIFIVE_PLIC
    select SOPHGO_CV1800B_CLK
    select DW8250

config MILKV_DUO
    bool
    depends on RISCV64
    default y
    select SOPHGO_CV1800B
```

## hw/sd/Kconfig
```kconfig
config PL181
    bool
    select SD

config DW_MMC
    bool
    select SD

config SSI_SD
    bool
    depends on SSI
    select SD

config SD
    bool

config DW_MCI
    bool
    select REGISTER
    select SD

config SDHCI
    bool
    select SD

config ROCKCHIP_DWCMSHC
    bool
    select SDHCI

config SDHCI_PCI
    bool
    default y if PCI_DEVICES
    depends on PCI
    select SDHCI

config CADENCE_SDHCI
    bool
    select SDHCI

config K230_SDHCI
    bool
    select SDHCI

config SPACEMIT_K3_SDHCI
    bool
    select SDHCI

config AX650X_SDHCI
    bool
    select SDHCI
```

## hw/ssi/Kconfig
```kconfig
config PL022
    bool
    select SSI

config SIFIVE_SPI
    bool
    select SSI

config SSI
    bool

config K230_SPI
    bool
    select SSI
    select SSI_M25P80

config XILINX_SPI
    bool
    select SSI

config XILINX_SPIPS
    bool
    select SSI

config STM32F2XX_SPI
    bool
    select SSI

config STC8G_SPI
    bool
    select REGISTER
    select SSI

config BCM2835_SPI
    bool
    select SSI

config PNV_SPI
    bool
    select SSI

config ALLWINNER_A10_SPI
    bool
    select SSI
```

## target/mcs251/Kconfig
```kconfig
# SPDX-License-Identifier: GPL-2.0-or-later

config MCS251
    bool

config STC32
    bool
    select MCS251
```

## target/mcs51/Kconfig
```kconfig
# Copyright (c) 2026 Process Mission
#
# SPDX-License-Identifier: GPL-2.0-or-later

config MCS51
    bool

config MCS251
    bool
    select MCS51
```
